## esp32/ESP32-S3-LCD-0.85/example/ESP-IDF-5.5.1/01_factory/ESP32-S3-LCD-0.85/sdkconfig.defaults
```kconfig
CONFIG_ESP_DEFAULT_CPU_FREQ_MHZ_240=y
CONFIG_ESPTOOLPY_FLASHSIZE_8MB=y
CONFIG_ESPTOOLPY_FLASHMODE_QIO=y
CONFIG_PARTITION_TABLE_CUSTOM=y

CONFIG_LV_COLOR_DEPTH_16=y

CONFIG_LV_COLOR_DEPTH=16
CONFIG_LV_COLOR_16_SWAP=y
CONFIG_LV_USE_DEMO_WIDGETS=y
CONFIG_LV_USE_DEMO_MUSIC=y
CONFIG_LV_MEM_SIZE_KILOBYTES=48

CONFIG_LV_FONT_MONTSERRAT_12=y
CONFIG_LV_FONT_MONTSERRAT_14=y
CONFIG_LV_FONT_MONTSERRAT_16=y
CONFIG_LV_FONT_MONTSERRAT_20=y

CONFIG_SPIRAM=y
CONFIG_SPIRAM_MODE_OCT=y
CONFIG_SPIRAM_SPEED_80M=y

CONFIG_CODEC_I2C_BACKWARD_COMPATIBLE=n
```

## esp32/SH1106_lvgl/main/Kconfig.projbuild
```kconfig
menu "Blink Display Configuration"

    choice BLINK_DISPLAY_CONTROLLER
        prompt "Display Controller"
        default BLINK_DISPLAY_SH1106
        help
            Select the display controller family used by this app.

        config BLINK_DISPLAY_SH1106
            bool "SH1106 / SSD1306 (supported)"
            help
                Use the existing ssd1306 component driver.

        config BLINK_DISPLAY_SSD1327
            bool "SSD1327 (config only, driver not linked yet)"
            help
                Enables SSD1327-specific app configuration.
                A dedicated SSD1327 driver component is still required.
    endchoice

    config BLINK_SSD1327_WIDTH
        int "SSD1327 width"
        depends on BLINK_DISPLAY_SSD1327
        range 16 256
        default 128

    config BLINK_SSD1327_HEIGHT
        int "SSD1327 height"
        depends on BLINK_DISPLAY_SSD1327
        range 16 256
        default 128

    choice BLINK_SSD1327_I2C_ADDRESS
        prompt "SSD1327 I2C Address"
        depends on BLINK_DISPLAY_SSD1327
        default BLINK_SSD1327_I2C_ADDR_3D
        help
            I2C slave address of the SSD1327 display.

        config BLINK_SSD1327_I2C_ADDR_3C
            bool "0x3C"
            help
                I2C address 0x3C

        config BLINK_SSD1327_I2C_ADDR_3D
            bool "0x3D"
            help
                I2C address 0x3D (default)
    endchoice

    config BLINK_SSD1327_I2C_PORT
        int "SSD1327 I2C Port"
        depends on BLINK_DISPLAY_SSD1327
        range 0 1
        default 0
        help
            I2C port number (0 or 1).

endmenu
```
